## Yocto/meta-custom/conf/layer.conf
```bitbake
# We have a conf and classes directory, add to BBPATH
BBPATH .= ":${LAYERDIR}"

# We have recipes-* directories, add to BBFILES
BBFILES += "${LAYERDIR}/recipes-*/*/*.bb \
            ${LAYERDIR}/recipes-*/*/*.bbappend"

BBFILE_COLLECTIONS += "meta-custom"
BBFILE_PATTERN_meta-custom = "^${LAYERDIR}/"
BBFILE_PRIORITY_meta-custom = "8"

LAYERDEPENDS_meta-custom = "core meta-python networking-layer jupyter-layer arm-toolchain meta-arm meta-ti-bsp meta-ti-extras"
LAYERSERIES_COMPAT_meta-custom = "scarthgap"
```

## Yocto/meta-uthp/conf/distro/TruckHackingOS.conf
```bitbake
#@TYPE: Distribution
#@NAME: UTHP Custom Distro
#@DESCRIPTION: Custom distribution for UTHP based on Poky
DISTRO = "TruckHackingOS"
DISTRO_NAME = "TruckHackingOS"
DISTRO_VERSION = "1.0.0"
DISTRO_CODENAME = "(Poky Scarthgap 5.0.2)"
DISTRO_ID = "TruckHackingOS"
```

## Yocto/meta-uthp/conf/layer.conf
```bitbake
# We have a conf and classes directory, add to BBPATH
BBPATH .= ":${LAYERDIR}"

# We have recipes-* directories, add to BBFILES
BBFILES += "${LAYERDIR}/recipes-*/*/*.bb \
            ${LAYERDIR}/recipes-*/*/*.bbappend"

BBFILE_COLLECTIONS += "meta-uthp"
BBFILE_PATTERN_meta-uthp = "^${LAYERDIR}/"
BBFILE_PRIORITY_meta-uthp = "98"

LAYERDEPENDS_meta-uthp = "core meta-python meta-python2 networking-layer jupyter-layer arm-toolchain meta-arm meta-ti-bsp meta-ti-extras"
LAYERSERIES_COMPAT_meta-uthp = "scarthgap"
```

## Yocto/meta-uthp/conf/machine/uthp.conf
```bitbake
#@TYPE: Machine
#@NAME: Ultimate Truck Hacking Platform
#@DESCRIPTION: Custom configuration for UTHP based on BeagleBone

# Inherit settings from beaglebone.conf in meta-ti layer
require conf/machine/beaglebone.conf

# Override the WKS_FILE with our custom sdimage
# File naming convention for Yocto is image-machine.wks
WKS_FILE = "core-image.wks"

# Override the UBOOT_EXTLINUX_CONFIG with our custom extlinux.conf
UBOOT_EXTLINUX_CONFIG = "extlinux.conf"
```
